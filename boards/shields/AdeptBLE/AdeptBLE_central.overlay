/ {
    /* 1. 컴파일러가 인식할 가상 키스캔 장치 최종 지정 */
    chosen {
        zmk,kscan = &kscan0;
        zmk,matrix-transform = &default_transform;
    };

    /* 2. 물리 핀 간섭 없는 순수 수신기용 가상(Mock) 드라이버 선언 */
    kscan0: kscan {
        compatible = "zmk,kscan-mock";
        columns = <1>;
        rows = <1>;
        events = <0>;
    };

    /* 3. 에러를 뿜던 RC(0,0) 대신, 순수 정수 번호로 1행 1열의 크기를 정석 선언 */
    default_transform: keymap_transform_0 {
        compatible = "zmk,matrix-transform";
        rows = <1>;
        columns = <1>;
        map = <0>;
    };
};
